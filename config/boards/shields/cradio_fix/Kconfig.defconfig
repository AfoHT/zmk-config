## config/boards/shields/cradio_fix/Kconfig.shield
```kconfig
# Copyright (c) 2020 The ZMK Contributors
# SPDX-License-Identifier: MIT

config SHIELD_CRADIO_FIX_RIGHT
	def_bool $(shields_list_contains,cradio_fix_right)
```
